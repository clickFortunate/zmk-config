## config/west.yml
```yaml
manifest:
  remotes:
    - name: clickFortunate
      url-base: https://github.com/clickFortunate
  projects:
    - name: zmk
      remote: clickFortunate
      revision: main
      import: app/west.yml
  self:
    path: config
```
